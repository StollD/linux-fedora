## Documentation/devicetree/bindings/thermal/brcm,bcm2711-thermal.txt
```
Binding for Thermal Sensor driver for BCM2711 SoCs.

Required properties:
- compatible:		must be: "brcm,bcm2711-thermal"
- reg:			Address range of the thermal registers.
- clocks:		Phandle of the clock used by the thermal sensor.
- #thermal-sensor-cells:	should be 0 (see thermal.txt)

Example:

thermal-zones {
	cpu_thermal: cpu-thermal {
		polling-delay-passive = <0>;
		polling-delay = <1000>;

		thermal-sensors = <&thermal>;

		trips {
			cpu-crit {
				temperature	= <80000>;
				hysteresis	= <0>;
				type		= "critical";
			};
		};

		coefficients = <(-487)  410040>;

		cooling-maps {
		};
	};
};

thermal@7d5d2200 {
	compatible = "brcm,bcm2711-thermal";
	reg = <0x7d5d2200 0x4>;
	clocks = <&clocks BCM2835_CLOCK_TSENS>;
	#thermal-sensor-cells = <0>;
};
```
